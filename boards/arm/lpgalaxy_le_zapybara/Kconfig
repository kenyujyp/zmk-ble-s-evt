## boards/arm/lpgalaxy_le_zapybara/Kconfig
```kconfig
# SPDX-License-Identifier: MIT

config BOARD_ENABLE_DCDC
    bool "Enable DCDC mode"
    select SOC_DCDC_NRF52X
    default y
    depends on BOARD_LPGALAXY_LE_ZAPYBARA

config BOARD_ENABLE_DCDC_HV
    bool "Enable High Voltage DCDC converter"
    default y
    select SOC_DCDC_NRF52X_HV
    depends on BOARD_LPGALAXY_LE_ZAPYBARA
```

## boards/arm/lpgalaxy_le_zapybara/Kconfig.board
```kconfig
# Le Zapybara board configuration

# Copyright (c) 2020 The ZMK Contributors
# SPDX-License-Identifier: MIT
#imply ZMK_KSCAN_EC_MATRIX_DYNAMIC_POLL_RATE

config BOARD_LPGALAXY_LE_ZAPYBARA
    bool "Le Zapybara"
    depends on SOC_NRF52840_QIAA
```

## boards/arm/lpgalaxy_le_zapybara/lpgalaxy_le_zapybara_defconfig
```kconfig
# SPDX-License-Identifier: MIT

CONFIG_SOC_SERIES_NRF52X=y
CONFIG_SOC_NRF52840_QIAA=y
CONFIG_BOARD_LPGALAXY_LE_ZAPYBARA=y

# Enable MPU
CONFIG_ARM_MPU=y

# Enable during calibration. should be disable in production
CONFIG_LOG=y
CONFIG_ZMK_LOG_LEVEL_DBG=y
CONFIG_LOG_PRINTK=y
CONFIG_LOG_MODE_DEFERRED=y  # Critical for ISR safety

# enable GPIO
CONFIG_PINCTRL=y
CONFIG_GPIO=y
CONFIG_ADC=y

# battery reporting
CONFIG_ZMK_BATTERY_REPORTING=n

CONFIG_ZMK_USB=y
CONFIG_ZMK_BLE=y

# Don't use for now, until the accelerometer waker is working.
CONFIG_ZMK_SLEEP=n
#CONFIG_ZMK_IDLE_TIMEOUT=5000
#CONFIG_ZMK_IDLE_SLEEP_TIMEOUT=300000

# flash memory config
CONFIG_USE_DT_CODE_PARTITION=y
CONFIG_BUILD_OUTPUT_UF2=y

CONFIG_MPU_ALLOW_FLASH_WRITE=y
CONFIG_NVS=y
CONFIG_SETTINGS_NVS=y
CONFIG_FLASH=y
CONFIG_FLASH_PAGE_LAYOUT=y
CONFIG_FLASH_MAP=y


# shell command auto complete
CONFIG_SHELL=y
CONFIG_SHELL_TAB=y
# enable print functions
CONFIG_PRINTK=y

# enable I2C
CONFIG_I2C=y  
CONFIG_I2C_NRFX=y
```

## config/boards/arm/EC60BLE/Kconfig.defconfig
```kconfig
// For nRF52840 MCU (e.g., Nice!Nano v2)
CONFIG_SOC_PART_NUMBER_NRF52840=y

if SHIELD_EC60BLE

# Name must be less than 16 characters long!
config ZMK_KEYBOARD_NAME
    default "EC60BLE"

endif
```

## config/west.yml
```yaml
manifest:
  remotes:
  - name: zmkfirmware
    url-base: https://github.com/zmkfirmware
  - name: kenyujy
    url-base: https://github.com/kenyujyp
  # Additional modules containing boards/shields/custom code can be listed here as well
  # See https://docs.zephyrproject.org/3.2.0/develop/west/manifest.html#projects
  # imported ec module, for EC function!!!
  projects:
    - name: zmk
      remote: zmkfirmware
      revision: main
      import: app/west.yml
    - name: zmk-gpio-ec
      remote: kenyujy
      revision: main
    #- name: zmk-shell-cmd
    #  remote: kenyujy
    #  revision: main
  self:
    path: config

# putting extra file or folder in config will cause the board being not recognizable !!
# dummy trigger
```
